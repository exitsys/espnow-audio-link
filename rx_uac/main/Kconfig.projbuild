## rx_uac/main/Kconfig.projbuild
```kconfig
menu "Audio link"

    config ALINK_TX_MAC
        string "发射端 MAC 地址（留空 = 不校验）"
        default ""
        help
            只接受这个 MAC 发来的音频包。ESP-NOW 不加密，同信道上任何设备只要往
            接收端的地址发帧都会被当成音频，这一项是一道可选的白名单。

            留空（默认）= 不校验，行为和没有这个选项时完全一样。
            写法和发射端的「接收端 MAC 地址」一致，三种都接受：
            aa:bb:cc:dd:ee:ff、aa-bb-cc-dd-ee-ff、aabbccddeeff（正好 12 位）。

            填了但格式不对时不会启用校验，串口会打印错误和你填的原始内容。
            发射端上电时串口会打印「本机 xx:xx:...」，抄过来即可。

endmenu
```

## tx_uac/main/Kconfig.projbuild
```kconfig
menu "Audio link"

    config ALINK_RX_MAC
        string "接收端 MAC 地址"
        default "84:c7:bb:5a:73:94"
        help
            接收端那块 ESP32 的 WiFi MAC。接受三种写法，大小写都行：
            aa:bb:cc:dd:ee:ff、aa-bb-cc-dd-ee-ff、aabbccddeeff（正好 12 位）。
            ESP-NOW 是单播，必须知道对端地址。

            格式不对（少一位、多一段、某段超过 FF）时，固件会退回内置默认值，
            并在串口打印你填的原始内容 —— 不会悄悄解析成另一个地址。

            接收端上电时串口会打印自己的 MAC，抄过来填这里，再重新编译烧录。

endmenu
```
